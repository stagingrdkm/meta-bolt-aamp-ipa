## conf/layer.conf
```bitbake
BBPATH .= ":${LAYERDIR}"

BBFILES += "${LAYERDIR}/recipes-*/*/*.bb \
            ${LAYERDIR}/recipes-*/*/*.bbappend "

BBFILE_COLLECTIONS += "bolt-aamp-ipa"
BBFILE_PATTERN_bolt-aamp-ipa = "^${LAYERDIR}/"
BBFILE_PRIORITY_bolt-aamp-ipa = "10"

LAYERDEPENDS_bolt-aamp-ipa = "bolt-base"
```
